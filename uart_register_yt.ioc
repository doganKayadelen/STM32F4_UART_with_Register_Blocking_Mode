# file: uart_register_yt.ioc
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Mcu.Family=STM32F4
Mcu.Name=STM32F407V(E-G)Tx
Mcu.Package=LQFP100
NVIC.PriorityGroup=NVIC_PRIORITYGROUP_4
PA13.Mode=Serial_Wire
PA13.Signal=SYS_JTMS-SWDIO
PA14.Mode=Serial_Wire
PA14.Signal=SYS_JTCK-SWCLK
PH0-OSC_IN.Mode=HSE-External-Oscillator
PH0-OSC_IN.Signal=RCC_OSC_IN
PH1-OSC_OUT.Mode=HSE-External-Oscillator
PH1-OSC_OUT.Signal=RCC_OSC_OUT
ProjectManager.HeapSize=0x200
ProjectManager.StackSize=0x400
ProjectManager.TargetToolchain=STM32CubeIDE
RCC.48MHZClocksFreq_Value=84000000
RCC.AHBFreq_Value=168000000
RCC.APB1CLKDivider=RCC_HCLK_DIV4
RCC.APB1Freq_Value=42000000
RCC.APB1TimFreq_Value=84000000
RCC.APB2CLKDivider=RCC_HCLK_DIV2
RCC.APB2Freq_Value=84000000
RCC.APB2TimFreq_Value=168000000
RCC.CortexFreq_Value=168000000
RCC.HCLKFreq_Value=168000000
RCC.HSE_VALUE=8000000
RCC.HSI_VALUE=16000000
RCC.LSE_VALUE=32768
RCC.PLLM=4
RCC.PLLN=168
RCC.PLLSourceVirtual=RCC_PLLSOURCE_HSE
RCC.SYSCLKFreq_VALUE=168000000
RCC.SYSCLKSource=RCC_SYSCLKSOURCE_PLLCLK
RCC.VCOOutputFreq_Value=336000000
board=custom

// file: Core/Src/main.c
/* USER CODE BEGIN Header */
/**
  ******************************************************************************
  * @file           : main.c
  * @brief          : Main program body
  ******************************************************************************
  * @attention
  *
  * Copyright (c) 2022 STMicroelectronics.
  * All rights reserved.
  *
  * This software is licensed under terms that can be found in the LICENSE file
  * in the root directory of this software component.
  * If no LICENSE file comes with this software, it is provided AS-IS.
  *
  ******************************************************************************
  */
/* USER CODE END Header */
#include "main.h"

void SystemClock_Config(void);
static void MX_GPIO_Init(void);

/* USER CODE BEGIN 0 */
void uart2Config(void){
	// UART VE GPIO CLOCKLARINI AKTIF ET
	RCC->APB1ENR |= (1<<17); // UART 2 CLOCK AKTIF
	RCC-> AHB1ENR |= (1<<0); // GPIOA CLOK AKTIF

	// UART PINLERINI ALTERNATIF FONKSIYON YAPMA
	GPIOA-> MODER |= (2<<4); // BIT 4 5 = 1:0 ALTERNATIF FONKSIYON PA2
	GPIOA-> MODER |= (2<<6); // BIT 6 7 = 1:0 ALTERNATIF FONKSIYON PA3

	GPIOA-> OSPEEDR |= (3<<4) | (3<<6); // PA2 VE PA3 PIN HIZI MAKSIMUM

	GPIOA-> AFR[0] |= (7<<8); // BYTE 8 9 10 11 AF7 ALTERNATIF FONKSIYON UART2 PA2
	GPIOA-> AFR[0] |= (7<<12); // BYTE 12 13 14 15 AF7 ALTERNATIF FONKSIYON UART2 PA3

	USART2-> CR1 = 0X00;
	USART2-> CR1 |= (1<<13); // UE 1 AKTIF USART

	USART2-> CR1 &= ~(1<<12); // M 0 8 BIT UZUNLUK

	USART2-> BRR |= (13 << 0) | (22 << 4); //115200 APB2 42MH/16*115200 22,786 0,786*16 12,57 13

	USART2-> CR1 |= (1<<2); // RECEIVE ALMA
	USART2-> CR1 |= (1<<3); // TRANSMIT ILETME
}

void uart2SendChar(uint8_t c){
	// USART DR YAZMACINA DATAYI YAZ
	USART2-> DR = c;
	while(!(USART2->SR & (1 << 6))); //TC BITI 1 OLUNCA TRANSFER TAMAM TC 1 OLUNCAYA KADAR BEKLE
}

void uart2SendString(char *str){
	// STRING GONDERME ICIN SENDCHAR FONK KULLAN
	while(*str)
		uart2SendChar(*str++);
}

uint8_t uart2GetChar(void){
	uint8_t temp;
	while(!(USART2->SR & (1 << 5))); // RXNE BITININ 1 OLMASINI BEKLE

	temp = USART2->DR;
	return temp;
}

/* USER CODE END 0 */

int main(void)
{

  /* MCU Configuration--------------------------------------------------------*/

  /* Reset of all peripherals, Initializes the Flash interface and the Systick. */
  HAL_Init();

  /* Configure the system clock */
  SystemClock_Config();

  /* Initialize all configured peripherals */
  MX_GPIO_Init();
  /* USER CODE BEGIN 2 */
  uart2Config();
  /* USER CODE END 2 */

  /* Infinite loop */
  while (1)
  {

    /* USER CODE BEGIN 3 */
	  //uart2SendChar('d');
	  //HAL_Delay(1000);
	  uint8_t data = uart2GetChar();
	  uart2SendChar(data);
  }
  /* USER CODE END 3 */
}

void SystemClock_Config(void)
{
  RCC_OscInitTypeDef RCC_OscInitStruct = {0};
  RCC_ClkInitTypeDef RCC_ClkInitStruct = {0};

  /** Configure the main internal regulator output voltage
  */
  __HAL_RCC_PWR_CLK_ENABLE();
  __HAL_PWR_VOLTAGESCALING_CONFIG(PWR_REGULATOR_VOLTAGE_SCALE1);
  /** Initializes the RCC Oscillators according to the specified parameters
  * in the RCC_OscInitTypeDef structure.
  */
  RCC_OscInitStruct.OscillatorType = RCC_OSCILLATORTYPE_HSE;
  RCC_OscInitStruct.HSEState = RCC_HSE_ON;
  RCC_OscInitStruct.PLL.PLLState = RCC_PLL_ON;
  RCC_OscInitStruct.PLL.PLLSource = RCC_PLLSOURCE_HSE;
  RCC_OscInitStruct.PLL.PLLM = 4;
  RCC_OscInitStruct.PLL.PLLN = 168;
  RCC_OscInitStruct.PLL.PLLP = RCC_PLLP_DIV2;
  RCC_OscInitStruct.PLL.PLLQ = 4;
  if (HAL_RCC_OscConfig(&RCC_OscInitStruct) != HAL_OK)
  {
    Error_Handler();
  }
  /** Initializes the CPU, AHB and APB buses clocks
  */
  RCC_ClkInitStruct.ClockType = RCC_CLOCKTYPE_HCLK|RCC_CLOCKTYPE_SYSCLK
                              |RCC_CLOCKTYPE_PCLK1|RCC_CLOCKTYPE_PCLK2;
  RCC_ClkInitStruct.SYSCLKSource = RCC_SYSCLKSOURCE_PLLCLK;
  RCC_ClkInitStruct.AHBCLKDivider = RCC_SYSCLK_DIV1;
  RCC_ClkInitStruct.APB1CLKDivider = RCC_HCLK_DIV4;
  RCC_ClkInitStruct.APB2CLKDivider = RCC_HCLK_DIV2;

  if (HAL_RCC_ClockConfig(&RCC_ClkInitStruct, FLASH_LATENCY_5) != HAL_OK)
  {
    Error_Handler();
  }
}

static void MX_GPIO_Init(void)
{

  /* GPIO Ports Clock Enable */
  __HAL_RCC_GPIOH_CLK_ENABLE();
  __HAL_RCC_GPIOA_CLK_ENABLE();

}

void Error_Handler(void)
{
  __disable_irq();
  while (1)
  {
  }
}
